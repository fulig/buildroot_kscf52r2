## board/kscf52r2/Patches/Kconfig.patch
```kconfig
--- output/build/linux-5.10/arch/m68k/Kconfig.cpu	2020-12-13 23:41:30.000000000 +0100
+++ changed_files/linux-3.x/arch/m68k/Kconfig.cpu	2020-12-15 17:04:15.563696026 +0100
@@ -28,7 +28,7 @@
 	select CPU_HAS_NO_MULDIV64
 	select GENERIC_CSUM
 	select GPIOLIB
-	select HAVE_LEGACY_CLK
+	select HAVE_CLK
 
 endchoice
 
@@ -159,6 +159,14 @@
 	help
 	   Freescale Coldfire 5207/5208 processor support.
 
+config KSCF52xx
+  bool "KSCF52xx"
+  depends on !MMU
+  select GENERIC_CLOCKEVENTS
+  select HAVE_CACHE_SPLIT
+  help
+    University of Kassel 1oo2 Safety SoC based on CFv2SPP5208.
+
 config M523x
 	bool "MCF523x"
 	depends on !MMU
@@ -343,7 +351,7 @@
 config ADVANCED
 	bool "Advanced configuration options"
 	depends on MMU
-	help
+	---help---
 	  This gives you access to some advanced options for the CPU. The
 	  defaults should be fine for most users, but these options may make
 	  it possible for you to improve performance somewhat if you know what
@@ -358,7 +366,7 @@
 config RMW_INSNS
 	bool "Use read-modify-write instructions"
 	depends on ADVANCED
-	help
+	---help---
 	  This allows to use certain instructions that work with indivisible
 	  read-modify-write bus cycles. While this is faster than the
 	  workaround of disabling interrupts, it can conflict with DMA
@@ -386,7 +394,7 @@
 config 060_WRITETHROUGH
 	bool "Use write-through caching for 68060 supervisor accesses"
 	depends on ADVANCED && M68060
-	help
+	---help---
 	  The 68060 generally uses copyback caching of recently accessed data.
 	  Copyback caching means that memory writes will be held in an on-chip
 	  cache and only written back to memory some time later.  Saying Y
```

## board/kscf52r2/patches/Kconfig.patch
```kconfig
--- /home/misterdulister/Coding/buildroot_kscf52r2/output/build/linux-5.4.45/arch/m68k/Kconfig.cpu	2020-06-07 13:18:52.000000000 +0200
+++ /home/misterdulister/Coding/buildroot_kscf52r2/changed_files/linux-3.x/arch/m68k/Kconfig.cpu	2021-01-26 11:04:59.232196312 +0100
@@ -159,6 +159,14 @@
 	help
 	   Freescale Coldfire 5207/5208 processor support.
 
+config KSCF52xx
+  bool "KSCF52xx"
+  depends on !MMU
+  select GENERIC_CLOCKEVENTS
+  select HAVE_CACHE_SPLIT
+  help
+    University of Kassel 1oo2 Safety SoC based on CFv2SPP5208.
+
 config M523x
 	bool "MCF523x"
 	depends on !MMU
```

## configs/kscf52r2_defconfig
```kconfig
BR2_m68k=y
BR2_m68k_cf5208=y
BR2_CCACHE=y
BR2_ENABLE_DEBUG=y
BR2_DEBUG_3=y
# BR2_STRIP_strip is not set
BR2_OPTIMIZE_G=y
BR2_TOOLCHAIN_BUILDROOT_CXX=y
BR2_PACKAGE_HOST_GDB=y
BR2_PACKAGE_HOST_GDB_TUI=y
BR2_PACKAGE_HOST_GDB_PYTHON=y
BR2_TARGET_GENERIC_HOSTNAME="RESCuV2"
BR2_TARGET_GENERIC_ISSUE="Welcome to Buildroot \\n on the RESCuV2 Safety System on a Chip"
BR2_TARGET_GENERIC_ROOT_PASSWD="root"
BR2_ROOTFS_POST_BUILD_SCRIPT="board/kscf52r2/post_build.sh"

BR2_LINUX_KERNEL=y
BR2_LINUX_KERNEL_USE_CUSTOM_CONFIG=y
BR2_LINUX_KERNEL_CUSTOM_CONFIG_FILE="board/kscf52r2/linux.config"

BR2_PACKAGE_CRAMFS=y
BR2_PACKAGE_GENROMFS=y
BR2_PACKAGE_MTD=y
BR2_PACKAGE_MTD_MKFSJFFS2=y
# BR2_PACKAGE_MTD_NANDDUMP is not set
# BR2_PACKAGE_MTD_NANDTEST is not set
# BR2_PACKAGE_MTD_NANDWRITE is not set
# BR2_PACKAGE_MTD_UBIATTACH is not set
# BR2_PACKAGE_MTD_UBICRC32 is not set
# BR2_PACKAGE_MTD_UBIDETACH is not set
# BR2_PACKAGE_MTD_UBIFORMAT is not set
# BR2_PACKAGE_MTD_UBIMKVOL is not set
# BR2_PACKAGE_MTD_UBINFO is not set
# BR2_PACKAGE_MTD_UBINIZE is not set
# BR2_PACKAGE_MTD_UBIRENAME is not set
# BR2_PACKAGE_MTD_UBIRMVOL is not set
# BR2_PACKAGE_MTD_UBIRSVOL is not set
# BR2_PACKAGE_MTD_UBIUPDATEVOL is not set
# BR2_PACKAGE_MTD_UBIBLOCK is not set
BR2_TARGET_ROOTFS_CPIO_GZIP=y
BR2_TARGET_ROOTFS_CPIO_UIMAGE=y
BR2_TARGET_ROOTFS_INITRAMFS=y
# BR2_TARGET_ROOTFS_TAR is not set
```
